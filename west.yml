## west.yml
```yaml
# Copyright (c) 2024 Microchip Technologies
# SPDX-License-Identifier: Apache-2.0

manifest:
  self:
    west-commands: scripts/west-commands.yml

  remotes:
    - name: pic64gx-zephyrproject-rtos
      url-base: https://github.com/pic64gx

  projects:
    - name: pic64gx-zephyr
      remote: pic64gx-zephyrproject-rtos
      revision: 4f46662ffb014fe30b74ac7c25a2d2ede7894b33
      path: zephyr
      import:
        name-allowlist:
          - hal_microchip
          - open-amp
          - libmetal
```
